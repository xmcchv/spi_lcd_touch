## sdkconfig.defaults
```kconfig
CONFIG_LV_CONF_SKIP=y
CONFIG_LV_USE_OBSERVER=y
CONFIG_LV_USE_SYSMON=y

CONFIG_EXAMPLE_LCD_TOUCH_ENABLED=y
CONFIG_EXAMPLE_LCD_TOUCH_CONTROLLER_XPT2046=y
CONFIG_EXAMPLE_LCD_CONTROLLER_ILI9341=y

CONFIG_MBEDTLS_CERTIFICATE_BUNDLE=y
CONFIG_MBEDTLS_CERTIFICATE_BUNDLE_DEFAULT_FULL=y
```
